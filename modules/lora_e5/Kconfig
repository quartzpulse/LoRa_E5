## modules/lora_e5/Kconfig
```kconfig
# LoRa-E5 Zephyr library configuration
#
# SPDX-License-Identifier: Apache-2.0

menuconfig LORA_E5
	bool "LoRa-E5-HF LoRaWAN modem library"
	depends on UART_ASYNC_API
	select GPIO
	help
	  Event-driven Zephyr library managing the full LoRa-E5-HF modem
	  lifecycle (boot/config/join/send/sleep/recovery) through the
	  module's AT command firmware. See modules/lora_e5/docs/ for the
	  full architecture.

	  Requires CONFIG_UART_ASYNC_API=y (and whatever the target board's
	  serial driver needs to support it, e.g. CONFIG_SERIAL_SUPPORT_ASYNC)
	  to be enabled explicitly by the application -- deliberately a
	  `depends on`, not a `select`: unlike select, this doesn't risk
	  forcing an unsatisfiable Kconfig combination on a board whose
	  serial driver can't actually support the async API.

if LORA_E5

module = LORA_E5
module-str = lora_e5
source "subsys/logging/Kconfig.template.log_config"

config LORA_E5_HAS_RESET_GPIO
	bool "Hardware reset GPIO available"
	help
	  Enable if the target board wires a `reset-gpios` devicetree
	  property to the LoRa-E5's NRST pin. When disabled (the
	  default), the Modem Manager falls back to AT+RESET-only
	  recovery, which cannot recover a modem that can't parse AT
	  commands at all. Never hardcoded -- see
	  docs/Phase1-Architecture.md decision on reset backend
	  abstraction.

config LORA_E5_RX_STACK_SIZE
	int "RX work queue stack size"
	default 1536
	help
	  Stack for the dedicated work queue running UART line assembly,
	  AT parsing, and AT Command Manager response routing.

config LORA_E5_FSM_STACK_SIZE
	int "FSM work queue stack size"
	default 2048
	help
	  Stack for the dedicated work queue running every FSM state
	  transition -- the single writer of FSM state.

config LORA_E5_NOTIFY_STACK_SIZE
	int "Application-callback notify work queue stack size"
	default 1024
	help
	  Stack for the dedicated, lower-priority work queue that
	  invokes the application's registered callback, decoupling
	  application callback latency/blocking from modem processing.

config LORA_E5_RX_BUFFER_SIZE
	int "UART RX ring buffer size"
	default 600
	help
	  Must exceed the largest realistic single line. Worst case is a
	  MSGHEX/CMSGHEX downlink with a 242-byte payload hex-encoded
	  (2 chars/byte) plus URC framing.

config LORA_E5_UART_LINE_QUEUE_DEPTH
	int "UART assembled-line queue depth"
	default 4
	help
	  Bounds the small fixed-depth queue of assembled lines handed
	  off from the UART callback (cheap, possibly ISR context) to
	  the RX work queue (line copy + parse).

config LORA_E5_CMD_QUEUE_DEPTH
	int "AT command queue depth"
	default 8
	help
	  Bounded array size for AT commands queued behind the one
	  currently in flight.

config LORA_E5_CMD_TIMEOUT_MS
	int "Generic AT transaction timeout (ms)"
	default 2000
	help
	  Per-command timeout for short transactions (config, query).
	  Separate from CONFIG_LORA_E5_TX_TIMEOUT_MS -- see that
	  symbol's help text.

config LORA_E5_TX_TIMEOUT_MS
	int "MSG/CMSG transaction timeout (ms)"
	default 10000
	help
	  A confirmed uplink's internal retry ladder (module-side
	  AT+RETRY, 3-10s randomized delay per attempt) can legitimately
	  take much longer than a simple config query -- using one
	  generic timeout for both risks false-timeout on TX or
	  absurdly long waits on trivial queries.

config LORA_E5_JOIN_TIMEOUT_MS
	int "Single join attempt timeout (ms)"
	default 15000
	help
	  Bounds one AT+JOIN transaction end-to-end (Start/NetID/Done
	  URCs are intermediate lines within this one transaction, not
	  separate transactions).

config LORA_E5_BOOT_SETTLE_MS
	int "Post-reset boot settle delay (ms)"
	default 500
	help
	  No fixed "boot complete" URC is documented for this module --
	  the FSM's BOOT state waits this long after issuing a reset
	  before probing with plain AT.

config LORA_E5_MAX_RETRIES
	int "Generic transport / recovery-ladder retry bound"
	default 3
	help
	  Bounds both AT Command Manager transport-level retries and the
	  number of full recovery-ladder passes (reset -> reconfigure ->
	  rejoin) attempted before giving up and entering ERROR.

config LORA_E5_JOIN_MAX_RETRIES
	int "Join-specific retry bound"
	default 3
	help
	  Kept separate from CONFIG_LORA_E5_MAX_RETRIES since join
	  failures interact with the modem's own join duty-cycle
	  limitation (spec §3.5). Not currently consumed by a dedicated
	  join-retry counter distinct from the recovery ladder's own
	  CONFIG_LORA_E5_MAX_RETRIES bound -- reserved for that future
	  refinement.

config LORA_E5_AUTO_REJOIN
	bool "Automatically rejoin after recovery"
	default y
	help
	  If enabled, the recovery ladder attempts AT+JOIN again after a
	  successful reconfigure, when the modem was JOINED (or had a TX
	  in flight) before the fault. If disabled, the ladder stops at
	  READY and leaves rejoining to the application -- some products
	  intentionally don't want silent rejoin (regulatory
	  duty-cycle-sensitive deployments).

config LORA_E5_AUTO_RESET
	bool "Watchdog-style self-reset from ERROR"
	default n
	help
	  Reserved for a future last-resort self-heal on a long
	  timescale (minutes, not seconds) for genuinely unattended
	  deployments. NOT implemented as an actual timer in this pass --
	  see docs/VERIFICATION_NEEDED.md. Enabling this symbol today has
	  no effect.

config LORA_E5_AUTO_RESET_TIMEOUT_MS
	int "CONFIG_LORA_E5_AUTO_RESET timeout (ms)"
	depends on LORA_E5_AUTO_RESET
	default 300000
	help
	  How long ERROR persists before an auto-reset would fire, once
	  CONFIG_LORA_E5_AUTO_RESET is actually implemented.

config LORA_E5_EVENT_QUEUE_DEPTH
	int "FSM / notify event queue depth"
	default 16
	help
	  Bounded k_msgq depth shared by both the FSM's internal event
	  queue and the notify subsystem's application-event queue.
	  Sizing this too small under bursty downlink+URC conditions
	  drops events (logged, not silent).

config LORA_E5_TX_BUFFER_SIZE
	int "Static TX staging buffer size"
	default 242
	help
	  Static buffer the public API copies application TX data into
	  before returning (caller's buffer does not need to outlive the
	  call). Sized against the worst-case 242-byte LoRaWAN payload
	  (Table 3-3) across every supported region/DR.

config LORA_E5_DEFAULT_REGION
	int "Default region (enum lora_e5_region ordinal)"
	default 0
	help
	  Reserved -- v1 requires the application to call
	  lora_e5_set_region() explicitly before lora_e5_start(); this
	  symbol is not currently consumed by any code path.

config LORA_E5_SHELL
	bool "LoRa-E5 shell commands"
	depends on SHELL
	help
	  Reserved for a future samples/shell/ integration -- not yet
	  implemented.

endif # LORA_E5
```

## modules/lora_e5/tests/cmd_queue/testcase.yaml
```yaml
tests:
  lora_e5.cmd_queue:
    platform_allow: native_sim
    tags: lora_e5 cmd_queue
    integration_platforms:
      - native_sim
```

## modules/lora_e5/tests/fsm/testcase.yaml
```yaml
tests:
  lora_e5.fsm:
    platform_allow: native_sim
    tags: lora_e5 fsm
    integration_platforms:
      - native_sim
```

## modules/lora_e5/tests/modem_manager/testcase.yaml
```yaml
tests:
  lora_e5.modem_manager:
    platform_allow: native_sim
    tags: lora_e5 modem_manager
    integration_platforms:
      - native_sim
```

## modules/lora_e5/tests/parser/testcase.yaml
```yaml
tests:
  lora_e5.parser:
    platform_allow: native_sim
    tags: lora_e5 parser
    integration_platforms:
      - native_sim
```

## modules/status_led/Kconfig
```kconfig
# ==============================================================================
# Portable RGB Status LED Library (out-of-tree Zephyr module)
# ==============================================================================

menuconfig STATUS_LED
	bool "Portable RGB status LED library"
	default n
	help
	  Priority-based RGB status LED state machine. Applications call only
	  status_led_init() / status_led_set_state() / status_led_clear_state() /
	  status_led_get_state() and never touch GPIO/PWM/SPI directly.

if STATUS_LED

choice STATUS_LED_BACKEND
	prompt "LED hardware backend"
	default STATUS_LED_BACKEND_WS2812
	help
	  Selects which hardware abstraction layer renders the resolved
	  (color, brightness) frame onto physical LED hardware.

config STATUS_LED_BACKEND_WS2812
	bool "WS2812 addressable RGB LED (SPI)"
	select SPI
	select LED_STRIP
	select LED_STRIP_WS2812_SPI
	help
	  Single WS2812/compatible addressable RGB LED driven over SPI via
	  Zephyr's led_strip API. Resolved from the "led-strip" devicetree
	  alias. Brightness is applied by scaling RGB values in software.

config STATUS_LED_BACKEND_GPIO
	bool "3x discrete GPIO (R/G/B)"
	select GPIO
	help
	  Three GPIO-driven LED legs (on/off only, no dimming). Resolved from
	  "red-led" / "green-led" / "blue-led" devicetree aliases.

config STATUS_LED_BACKEND_PWM
	bool "3x PWM channel (R/G/B)"
	select PWM
	help
	  Three PWM-driven LED channels with true brightness control via duty
	  cycle. Resolved from "pwm-red-led" / "pwm-green-led" / "pwm-blue-led"
	  devicetree aliases.

config STATUS_LED_BACKEND_MONO_GPIO
	bool "Monochrome LED via single GPIO"
	select GPIO
	help
	  A single GPIO-driven LED (on/off only, no dimming) for boards with no
	  RGB hardware. Each pattern's color is collapsed to one intensity via
	  max(r, g, b) before thresholding. Resolved from the "mono-led"
	  devicetree alias. Distinct states that only differ by color (not by
	  blink pattern) will look identical on monochrome hardware.

config STATUS_LED_BACKEND_MONO_PWM
	bool "Monochrome LED via single PWM channel"
	select PWM
	help
	  A single PWM-driven LED channel with true brightness control via duty
	  cycle, for boards with no RGB hardware. Each pattern's color is
	  collapsed to one intensity via max(r, g, b). Resolved from the
	  "pwm-mono-led" devicetree alias.

endchoice

config STATUS_LED_DEFAULT_BRIGHTNESS
	int "Default brightness (0-255)"
	range 0 255
	default 76
	help
	  Global brightness scale applied to every pattern's color, 0-255.
	  Default of 76 is approximately 30%.

config STATUS_LED_UPDATE_PERIOD_MS
	int "Breathing/fade tick period (ms)"
	range 5 1000
	default 20
	help
	  Sampling period for the breathing (fade) pattern's brightness ramp.
	  Patterns other than breathing are event-scheduled and do not use
	  this tick.

config STATUS_LED_PRIORITY_ENGINE
	bool "Enable priority engine"
	default y
	help
	  When enabled (default), multiple simultaneously active states are
	  resolved to the single highest-priority state per the fixed
	  priority table. Disabling this is not currently supported and is
	  reserved for future use.

module = STATUS_LED
module-str = status_led
source "subsys/logging/Kconfig.template.log_config"

endif # STATUS_LED
```
